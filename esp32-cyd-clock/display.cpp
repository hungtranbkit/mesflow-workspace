#include "display.h"
// Custom GFXfont for the clock digits ONLY, loaded via TFT_eSPI's
// GFXFF support (tft.setFreeFont(), needs -DLOAD_GFXFF -- see
// build_and_flash.sh). Generated by tools/gen_clock_font.py, targeting
// 240-255 x 85-95px for "14:25".
//
// 3 candidates generated this round for a font-quality A/B/C comparison
// (via the screenshot pipeline, see FONT_CANDIDATES_LOG.md):
//   0 = ClockDigits.h  (LiberationSansNarrow-Bold, 253x93 -- previous/current)
//   1 = ClockFontB.h   (NimbusSans-Bold,           254x89 -- regular width, humanist)
//   2 = ClockFontC.h   (DejaVuSansMono-Bold,        255x87 -- monospace, perfectly stable digit width)
#define CLOCK_FONT_CANDIDATE 0 // selected winner -- see FONT_CANDIDATES_LOG.md
#if CLOCK_FONT_CANDIDATE == 0
#include "ClockDigits.h"
#define CLOCK_FONT ClockDigits
#elif CLOCK_FONT_CANDIDATE == 1
#include "ClockFontB.h"
#define CLOCK_FONT ClockFontB
#elif CLOCK_FONT_CANDIDATE == 2
#include "ClockFontC.h"
#define CLOCK_FONT ClockFontC
#endif

// TFT_eSPI instance -- pins/driver come from compiler.cpp.extra_flags
// (build_and_flash.sh), NOT from a User_Setup.h edit. See display.h.
TFT_eSPI tft = TFT_eSPI();

#define TFT_BL_PIN 21 // backlight, same GPIO as the old stack; driven manually (no TFT_BL define passed to TFT_eSPI)

static int W = 0, H = 0;

struct Band { int16_t x, y, w, h; };
// Simple 3-row layout per the migration spec: one header row (date
// left, wifi right, side by side), one clock row (centered, large),
// one weather row (centered, single line). No cards, no side-by-side
// complexity beyond the header's own two halves.
static Band BAND_DATE, BAND_WIFI, BAND_CLOCK, BAND_WEATHER;

static const uint16_t COLOR_BG   = TFT_BLACK;
static const uint16_t COLOR_FG   = TFT_WHITE;
static const uint16_t COLOR_DIM  = TFT_DARKGREY;
static const uint16_t COLOR_WARN = TFT_ORANGE;

static void clearBand(const Band &b) {
  tft.fillRect(b.x, b.y, b.w, b.h, COLOR_BG);
}

// ---- Clock font: ClockDigits (custom GFXfont, see the #include
// comment above). Measured once at boot and logged -- not chosen at
// runtime from candidates this round, since the generator already
// targets the exact box directly. ----
static void logClockFontMetrics() {
  tft.setFreeFont(&CLOCK_FONT);
  tft.setTextSize(1);
  int w = tft.textWidth("16:35");
  int h = tft.fontHeight();
  Serial.printf("[FONT TEST] candidate=%d -> %dx%d (target 240x85..255x95)\n", CLOCK_FONT_CANDIDATE, w, h);
}

// ---- Fixed regions. W is always 320 in this app's landscape
// rotation (documented, simple by design) -- header row splits into a
// 200px date half and a 120px wifi half (200+120=320), so each can be
// cleared/redrawn independently (RSSI changes redraw only BAND_WIFI,
// date changes redraw only BAND_DATE). ----
static void computeLayout() {
  const int16_t headerH = 30, weatherH = 30;
  const int16_t dateW = 200, wifiW = W - dateW;
  const int16_t clockH = H - headerH - weatherH;

  BAND_DATE    = {0, 0, dateW, headerH};
  BAND_WIFI    = {dateW, 0, wifiW, headerH};
  BAND_CLOCK   = {0, headerH, (int16_t)W, clockH};
  BAND_WEATHER = {0, (int16_t)(headerH + clockH), (int16_t)W, weatherH};

  Serial.printf("[UI] Regions: date(x=%d,w=%d) wifi(x=%d,w=%d) clock(y=%d,h=%d) weather(y=%d,h=%d) W=%d H=%d\n",
    BAND_DATE.x, BAND_DATE.w, BAND_WIFI.x, BAND_WIFI.w,
    BAND_CLOCK.y, BAND_CLOCK.h, BAND_WEATHER.y, BAND_WEATHER.h, W, H);
}

void displayInit() {
  pinMode(TFT_BL_PIN, OUTPUT);
  digitalWrite(TFT_BL_PIN, HIGH);

  tft.init();
  const uint8_t rotation = 1; // physically verified correct landscape orientation -- BOARD_INFO.md
  tft.setRotation(rotation);
  W = tft.width();
  H = tft.height();
  Serial.printf("[DISPLAY] rotation=%d width=%d height=%d\n", rotation, W, H);

  tft.setTextWrap(false, false); // carried over from the old stack's mandatory fix -- never rely on auto-wrap
  tft.fillScreen(COLOR_BG);
  computeLayout();
  logClockFontMetrics();
}

// ---- Per-region change tracking -- redraw only what changed, per
// instruction. Whole-band clear (not per-glyph/per-slot) is
// acceptable for this first migrated version. ----
static String lastDateLine = "\x01";
static String lastWifiLine = "\x01";
static int lastHour = -1, lastMinute = -1;
static String lastWeatherLine = "\x01";

void displayUpdateHeader(const String &dayOfWeekVN, const String &dateStr, long rssi, bool wifiConnected) {
  // Plain ASCII separator ("-"), not the mockup's literal middle-dot --
  // real bug found from this migration's own boot log: a raw 0xB7 byte
  // is not valid UTF-8 (it's a continuation byte, not a leading byte),
  // so TFT_eSPI's decodeUTF8() mis-decoded it (printed as "?" on
  // Serial); TFT_eSPI's built-in classic fonts likely don't carry a
  // middle-dot glyph either way. Not worth chasing a real UTF-8 encode
  // for one separator character in a "keep it simple" migration.
  String dateLine = dayOfWeekVN + " - " + dateStr;
  if (dateLine != lastDateLine) {
    lastDateLine = dateLine;
    clearBand(BAND_DATE);
    tft.setTextFont(2);
    tft.setTextSize(1);
    tft.setTextColor(COLOR_FG, COLOR_BG);
    tft.setTextDatum(ML_DATUM);
    tft.drawString(dateLine, BAND_DATE.x + 4, BAND_DATE.y + BAND_DATE.h / 2);
    Serial.println("[UI] Date drawn: " + dateLine);
  }

  long roundedRssi = wifiConnected ? (((rssi >= 0 ? rssi + 2 : rssi - 2) / 5) * 5) : 0;
  String wifiLine = wifiConnected ? ("WiFi " + String(roundedRssi) + "dBm") : "WiFi offline";
  if (wifiLine != lastWifiLine) {
    lastWifiLine = wifiLine;
    clearBand(BAND_WIFI);
    tft.setTextFont(2);
    tft.setTextSize(1);
    tft.setTextColor(wifiConnected ? COLOR_DIM : COLOR_WARN, COLOR_BG);
    tft.setTextDatum(MR_DATUM);
    tft.drawString(wifiLine, BAND_WIFI.x + BAND_WIFI.w - 4, BAND_WIFI.y + BAND_WIFI.h / 2);
    Serial.println("[UI] WiFi drawn: " + wifiLine);
  }
}

// HH/colon/MM rendered as 3 separate pieces with deliberate gaps, not
// one "HH:MM" string -- real spacing bug found from a physical
// screenshot: the font's own advance metric around ':' put MM right up
// against the colon. Real total width computed from the 3 pieces' own
// measured widths + the 2 gaps, and the WHOLE group centered together
// (not each piece centered independently).
static const int16_t CLOCK_GAP1 = 12; // HH -> ':'  (target 8-14px)
static const int16_t CLOCK_GAP2 = 14; // ':' -> MM  (target 10-16px, slightly more generous per instruction)

void displayUpdateTime(int hour24, int minute) {
  if (hour24 == lastHour && minute == lastMinute) return;
  lastHour = hour24; lastMinute = minute;
  char hbuf[3], mbuf[3];
  snprintf(hbuf, sizeof(hbuf), "%02d", hour24);
  snprintf(mbuf, sizeof(mbuf), "%02d", minute);

  clearBand(BAND_CLOCK);
  tft.setFreeFont(&CLOCK_FONT);
  tft.setTextSize(1);
  tft.setTextColor(COLOR_FG, COLOR_BG);

  int hoursWidth = tft.textWidth(hbuf);
  int colonWidth = tft.textWidth(":");
  int minutesWidth = tft.textWidth(mbuf);
  int totalWidth = hoursWidth + CLOCK_GAP1 + colonWidth + CLOCK_GAP2 + minutesWidth;

  int16_t startX = BAND_CLOCK.x + (BAND_CLOCK.w - totalWidth) / 2;
  int16_t midY = BAND_CLOCK.y + BAND_CLOCK.h / 2;

  tft.setTextDatum(ML_DATUM); // left-anchored per piece; the GROUP is centered via startX above
  int16_t x = startX;
  tft.drawString(hbuf, x, midY); x += hoursWidth + CLOCK_GAP1;
  tft.drawString(":", x, midY);  x += colonWidth + CLOCK_GAP2;
  tft.drawString(mbuf, x, midY);

  tft.setFreeFont(); // revert to classic fonts for the next caller (header/weather use tft.setTextFont(2))
  Serial.printf("[UI] Clock drawn: %s:%s (hoursW=%d gap1=%d colonW=%d gap2=%d minutesW=%d totalW=%d)\n",
    hbuf, mbuf, hoursWidth, CLOCK_GAP1, colonWidth, CLOCK_GAP2, minutesWidth, totalWidth);
}

void displayUpdateWeather(const String &locationName, float tempC, const String &condition, bool haveWeather, bool stale) {
  char tbuf[8];
  if (haveWeather) snprintf(tbuf, sizeof(tbuf), "%.0fC", tempC); else snprintf(tbuf, sizeof(tbuf), "--");
  String condLine = haveWeather ? condition : "Weather offline";
  if (stale) condLine += " (stale)";
  String line = locationName + "   " + String(tbuf) + "   " + condLine;
  if (line == lastWeatherLine) return;
  lastWeatherLine = line;

  clearBand(BAND_WEATHER);
  tft.setTextFont(2);
  tft.setTextSize(1);
  tft.setTextColor(stale ? COLOR_WARN : COLOR_DIM, COLOR_BG);
  tft.setTextDatum(MC_DATUM);
  tft.drawString(line, BAND_WEATHER.x + BAND_WEATHER.w / 2, BAND_WEATHER.y + BAND_WEATHER.h / 2);
  Serial.println("[UI] Weather drawn: " + line);
}

// ---- Alarm overlay -- full-screen, does not permanently alter the
// normal clock UI. Reuses the clock's own custom font for the time
// (already sized right, no reason to duplicate) plus a plain classic
// font for the "ALARM" label. ----
void displayShowAlarmOverlay(int hour, int minute) {
  char buf[6];
  snprintf(buf, sizeof(buf), "%02d:%02d", hour, minute);

  tft.fillScreen(COLOR_BG);
  tft.setTextDatum(MC_DATUM);

  tft.setFreeFont(&CLOCK_FONT);
  tft.setTextSize(1);
  tft.setTextColor(COLOR_WARN, COLOR_BG);
  tft.drawString(buf, W / 2, H / 2 - 45);
  tft.setFreeFont(); // back to classic fonts

  tft.setTextFont(4);
  tft.setTextSize(1);
  tft.setTextColor(COLOR_WARN, COLOR_BG);
  tft.drawString("ALARM", W / 2, H / 2 + 55);

  Serial.println("[UI] Alarm overlay shown");
}

// Clears the overlay and invalidates every region's change-tracking
// cache so the very next displayUpdateHeader()/Time()/Weather() calls
// unconditionally repaint everything fresh -- no stale overlay pixels,
// no reliance on values happening to differ from what was last drawn.
void displayHideAlarmOverlay() {
  tft.fillScreen(COLOR_BG);
  lastDateLine = "\x01";
  lastWifiLine = "\x01";
  lastHour = -1;
  lastMinute = -1;
  lastWeatherLine = "\x01";
  Serial.println("[UI] Alarm overlay cleared, normal UI will repaint next tick");
}

// ---- Accessors for screenshot.cpp -- see its header comment for why
// this reads real GRAM via tft.readRect() instead of a shadow buffer. ----
int displayWidth() { return W; }
int displayHeight() { return H; }
void displayReadRow(int32_t y, uint16_t *outRow, int32_t w) {
  tft.readRect(0, y, w, 1, outRow);
}
